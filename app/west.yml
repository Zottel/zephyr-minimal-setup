## app/west.yml
```yaml
---
manifest:
  projects:
    - name: zephyr
      revision: v3.7.1
      url: https://github.com/zephyrproject-rtos/zephyr
      west-commands: scripts/west-commands.yml
      import:
        name-allowlist:
          - cmsis
          - hal_stm32
          - zcbor
          - zephyr

#         - mbedtls
#         - trusted-firmware-m
#         - tinycrypt
#         - picolibc
#         - mcuboot
#         - lvgl
#         - littlefs
#         - hal_rpi_pico
#         - hal_espressif
#         - fatfs
#         - hal_st
#         - cmsis
```

## west.yml
```yaml
---
manifest:
  projects:
    - name: zephyr
      revision: v3.7.1
      url: https://github.com/zephyrproject-rtos/zephyr
      west-commands: scripts/west-commands.yml
      clone-depth: 1

      import:
        path-prefix: zephyr
        name-allowlist:
          - zephyr

          - cmsis
          - hal_stm32
          - zcbor

#         - mbedtls
#         - trusted-firmware-m
#         - tinycrypt
#         - picolibc
#         - mcuboot
#         - lvgl
#         - littlefs
#         - hal_rpi_pico
#         - hal_espressif
#         - fatfs
#         - hal_st
```
